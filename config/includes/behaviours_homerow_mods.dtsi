#include <behaviors.dtsi>
#include <dt-bindings/zmk/keys.h>
#include <dt-bindings/zmk/bt.h>
#include <dt-bindings/zmk/mouse.h>

// ▼ ここから追加
#include "zmk-helpers/helper.h"

// roBa キーポジション定義
//
// 左手                                右手
//  0   1   2   3   4       5   6   7   8   9
// 10  11  12  13  14  15  16  17  18  19  20  21
// 22  23  24  25  26  27  28  29  30  31  32  33
// 34  35  36  37  38  39  40  41                42

// 左手（上3行のみ。RC(1,5) と RC(2,5) は左の最端キー）
#define KEYS_L  0  1  2  3  4 \
               10 11 12 13 14 15 \
               22 23 24 25 26 27 \
               34 35 36

// 右手（上3行のみ）
#define KEYS_R   5  6  7  8  9 \
                16 17 18 19 20 21 \
                28 29 30 31 32 33 \
                42

// 親指（最下段）
// 左: 37 38 39 / 右: 40 41 
#define THUMBS  37 38 39 40 41

/* 左手ホームロウモッド */
ZMK_HOLD_TAP(hml,
    flavor = "balanced";
    tapping-term-ms = <280>;
    quick-tap-ms = <175>;
    require-prior-idle-ms = <150>;
    bindings = <&kp>, <&kp>;
    hold-trigger-key-positions = <KEYS_R THUMBS>;
    hold-trigger-on-release;
)

/* 右手ホームロウモッド */
ZMK_HOLD_TAP(hmr,
    flavor = "balanced";
    tapping-term-ms = <280>;
    quick-tap-ms = <175>;
    require-prior-idle-ms = <150>;
    bindings = <&kp>, <&kp>;
    hold-trigger-key-positions = <KEYS_L THUMBS>;
    hold-trigger-on-release;
)
// ▲ ここまで追加